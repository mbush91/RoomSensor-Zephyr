## boards/arm/bleroomsensor/Kconfig.board
```kconfig
# Copyright (c) 2024 Nordic Semiconductor ASA
# SPDX-License-Identifier: Apache-2.0

config BOARD_BLEROOMSENSOR
	bool "BLERoomSensor"
	depends on SOC_NRF52811_QFAA
```

## boards/arm/bleroomsensor/Kconfig.defconfig
```kconfig
# Copyright (c) 2024 Nordic Semiconductor ASA
# SPDX-License-Identifier: Apache-2.0

if BOARD_BLEROOMSENSOR

config BOARD
	default "bleroomsensor"

config BT_CTLR
   default BT

config SPI
  default y

endif
```

## boards/arm/bleroomsensor/bleroomsensor_defconfig
```kconfig
# Copyright (c) 2024 Nordic Semiconductor ASA
# SPDX-License-Identifier: Apache-2.0

CONFIG_SOC_SERIES_NRF52X=y
CONFIG_SOC_NRF52811_QFAA=y
CONFIG_BOARD_BLEROOMSENSOR=y
CONFIG_BOARD_ENABLE_DCDC=y

# Enable MPU
CONFIG_ARM_MPU=y

# Enable hardware stack protection
CONFIG_HW_STACK_PROTECTION=y

CONFIG_CLOCK_CONTROL_NRF_K32SRC_SYNTH=y

CONFIG_PINCTRL=y
CONFIG_GPIO=y
```
