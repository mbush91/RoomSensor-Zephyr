## CMakeLists.txt
```
cmake_minimum_required(VERSION 3.20.0)
find_package(Zephyr REQUIRED HINTS $ENV{ZEPHYR_BASE})

project(soildSensor_zepyr)

target_include_directories(app PRIVATE
  ${CMAKE_CURRENT_SOURCE_DIR}/src
)


target_sources(app PRIVATE
  src/main.c
  src/ss_bt.c
  src/bt_coded.c
  src/bme280.c
  src/batt.c
  src/pwr.c
)
```

## Kconfig
```
menu "Zephyr Kernel"
  source "Kconfig.zephyr"

config BT_TX_RATE
  int "Frequency to TX advs in ms"

config TIME_BETWEEN_MEASURMENTS
  int "How long to sleep between broadcasts (seconds)"

config BT_TX_TIME
  int "How long to TX once we wake up (ms)"

endmenu
```

## prj.conf
```kconfig
# Bluetooth
CONFIG_BT=y

# CONFIG_BT_CTLR_ADV_EXT=y
# CONFIG_BT_CTLR_PHY_CODED=y
CONFIG_BT_CTLR_TX_PWR_ANTENNA=4
# CONFIG_BT_EXT_ADV=y
# CONFIG_BT_USER_PHY_UPDATE=y

CONFIG_BT_DEVICE_NAME="RoomSensor"

CONFIG_BT_TX_RATE=1000
CONFIG_TIME_BETWEEN_MEASURMENTS=55
CONFIG_BT_TX_TIME=5000

# Console and Logging
CONFIG_PRINTK=n

CONFIG_CONSOLE=n
CONFIG_STDOUT_CONSOLE=n
CONFIG_RTT_CONSOLE=n
CONFIG_USE_SEGGER_RTT=n
CONFIG_LOG=n
CONFIG_LOG_BACKEND_RTT=n

# CONFIG_CONSOLE=y
# CONFIG_STDOUT_CONSOLE=y
# CONFIG_RTT_CONSOLE=y
# CONFIG_USE_SEGGER_RTT=y
# CONFIG_LOG=y
# CONFIG_LOG_BACKEND_RTT=y

# CONFIG_NEWLIB_LIBC=y
# CONFIG_NEWLIB_LIBC_FLOAT_PRINTF=y
# CONFIG_CBPRINTF_FP_SUPPORT=y

CONFIG_GPIO=y

CONFIG_ADC=y
CONFIG_ADC_NRFX_SAADC=y

CONFIG_POWEROFF=y

CONFIG_PM_DEVICE=y
CONFIG_PM_DEVICE_RUNTIME=y

CONFIG_I2C=y
CONFIG_SENSOR=y
CONFIG_GPIO=y

# CONFIG_THREAD_ANALYZER=y
# CONFIG_THREAD_ANALYZER_AUTO=y
# CONFIG_THREAD_NAME=y
```

## src/main.c
```c
#include "ss_bt.h"
#include "bme280.h"
#include "batt.h"
#include "pwr.h"

#include <zephyr/kernel.h>
#include <zephyr/logging/log.h>

LOG_MODULE_REGISTER(main, LOG_LEVEL_INF);


int32_t init_done = 0;
struct bme280_sensor_vals temp, press, humidity;
int16_t batt_mv;

void main_loop(void *, void *, void*) {
    while (1)
    {
      if(init_done) {
        LOG_INF("Thread Running, BT Transmitting");

        k_msleep(CONFIG_BT_TX_TIME);

        pwr_sleep_bus(); // TODO, break this into a ACD/I2C sleep vs BT

        k_sleep(K_SECONDS(CONFIG_TIME_BETWEEN_MEASURMENTS));

        pwr_wake_bus();

        batt_mv = batt_read();
        bme280_read(&temp,&press,&humidity);

        ss_bt_update(temp,press,humidity,batt_mv);

      } else {
        k_msleep(50);
      }
    }
}

K_THREAD_DEFINE(main_loop_tid, 2048, main_loop, NULL, NULL, NULL, 2, 0, 0);

int main(void)
{
  batt_init();
  bme280_init();
  init_ss_bt();

  // Do inital reads
  batt_mv = batt_read();
  bme280_read(&temp,&press,&humidity);

  // Update and start ADV
  ss_bt_update(temp,press,humidity,batt_mv);

  init_done = 1;
}
```

## src/batt.c
```c
#include "batt.h"

#include <zephyr/device.h>
#include <zephyr/devicetree.h>
#include <zephyr/drivers/adc.h>
#include <zephyr/logging/log.h>

LOG_MODULE_REGISTER(batt, LOG_LEVEL_INF);

#if !DT_NODE_EXISTS(DT_PATH(zephyr_user)) || \
    !DT_NODE_HAS_PROP(DT_PATH(zephyr_user), io_channels)
#error "No suitable devicetree overlay specified"
#endif

#define DT_SPEC_AND_COMMA(node_id, prop, idx) \
  ADC_DT_SPEC_GET_BY_IDX(node_id, idx),

/* Data of ADC io-channels specified in devicetree. */
static const struct adc_dt_spec adc_channels[] = {
    DT_FOREACH_PROP_ELEM(DT_PATH(zephyr_user), io_channels,
                         DT_SPEC_AND_COMMA)};

void batt_init(void)
{
  int err;

  for (size_t i = 0U; i < ARRAY_SIZE(adc_channels); i++)
  {
    if (!adc_is_ready_dt(&adc_channels[i]))
    {
      LOG_ERR("ADC controller device %s not ready\n", adc_channels[i].dev->name);
      return;
    }
    else
    {
      LOG_INF("Device %s is ready", adc_channels[i].dev->name);
    }

    err = adc_channel_setup_dt(&adc_channels[i]);
    if (err < 0)
    {
      LOG_ERR("Could not setup channel #%d (%d)\n", i, err);
      return;
    }
    else
    {
      LOG_INF("Setup %s", adc_channels[i].dev->name);
    }
  }
}

int16_t batt_read(void)
{
  int32_t val_mv = 0;
  int err;
  uint16_t buf;
  struct adc_sequence sequence = {
      .buffer = &buf,
      /* buffer size in bytes, not number of samples */
      .buffer_size = sizeof(buf),
  };

  for (size_t i = 0U; i < ARRAY_SIZE(adc_channels); i++)
  {

    LOG_INF("- %s, channel %d: ",
           adc_channels[i].dev->name,
           adc_channels[i].channel_id);

    (void)adc_sequence_init_dt(&adc_channels[i], &sequence);

    err = adc_read(adc_channels[i].dev, &sequence);
    if (err < 0)
    {
      LOG_ERR("Could not read (%d)\n", err);
      continue;
    }

    val_mv = (int32_t)buf;

    LOG_INF("%" PRId32, val_mv);
    err = adc_raw_to_millivolts_dt(&adc_channels[i],
                                   &val_mv);
    /* conversion to mV may not be supported, skip if not */
    if (err < 0)
    {
      LOG_ERR(" (value in mV not available)\n");
    }
    else
    {
      LOG_INF(" = %" PRId32 " mV\n", val_mv);
    }
  }

  return (int16_t)val_mv;
}
```

## src/batt.h
```c
#ifndef RS_BATT
#define RS_BATT

#include <stdint.h>

void batt_init(void);
int16_t batt_read(void);

#endif // RS_BATT
```

## src/bme280.c
```c
#include "bme280.h"

#include <zephyr/kernel.h>
#include <zephyr/device.h>
#include <zephyr/devicetree.h>
#include <zephyr/drivers/sensor.h>
#include <zephyr/logging/log.h>

LOG_MODULE_REGISTER(bme280, LOG_LEVEL_INF);

static const struct device *dev = NULL;

static void get_bme280_device(void)
{
  dev = DEVICE_DT_GET_ANY(bosch_bme280);

  if (dev == NULL)
  {
    /* No such node, or the node does not have status "okay". */
    LOG_ERR("\nError: no device found.\n");
  }

  if (!device_is_ready(dev))
  {
    LOG_ERR("\nError: Device \"%s\" is not ready; "
            "check the driver initialization logs for errors.\n",
            dev->name);
  }

  LOG_INF("Found device \"%s\", getting sensor data\n", dev->name);
}

void bme280_init(void)
{
  get_bme280_device();
}

void bme280_read(struct bme280_sensor_vals *btemp, struct bme280_sensor_vals *bpress, struct bme280_sensor_vals *bhumidity)
{
  int err;
  struct sensor_value temp, press, humidity;

  if (dev != NULL)
  {
    err = sensor_sample_fetch(dev);
    if (!err)
    {
      sensor_channel_get(dev, SENSOR_CHAN_AMBIENT_TEMP, &temp);
      sensor_channel_get(dev, SENSOR_CHAN_PRESS, &press);
      sensor_channel_get(dev, SENSOR_CHAN_HUMIDITY, &humidity);

      LOG_INF("temp: %d.%06d; press: %d.%06d; humidity: %d.%06d\n",
              temp.val1, temp.val2, press.val1, press.val2,
              humidity.val1, humidity.val2);

      btemp->val1 = (int8_t)temp.val1;
      btemp->val2 = (int8_t)(temp.val2 / 10000);

      bpress->val1 = (int8_t)press.val1;
      bpress->val2 = (int8_t)(press.val2 / 10000);

      bhumidity->val1 = (int8_t)humidity.val1;
      bhumidity->val2 = (int8_t)(humidity.val2 / 10000);

      LOG_DBG("temp: %d.%d; press: %d.%d; humidity: %d.%d\n",
              btemp->val1, btemp->val2, bpress->val1, bpress->val2,
              bhumidity->val1, bhumidity->val2);
    }
    else
    {
      LOG_ERR("Boo");
    }
  }
}
```

## src/bme280.h
```c
#ifndef BME280_SENSOR
#define BME280_SENSOR

#include <zephyr/drivers/sensor.h>
#include <stdint.h>

struct bme280_sensor_vals {
	/** Integer part of the value. */
	int8_t val1;
	/** Fractional part of the value (in one-hundreth parts). */
	int8_t val2;
};



void bme280_init(void);
void bme280_read(
  struct bme280_sensor_vals* temp,
  struct bme280_sensor_vals* press,
  struct bme280_sensor_vals* humidity
);

#endif // BME280_SENSOR
```

## src/bt_coded.c
```c
#include <zephyr/kernel.h>
#include <zephyr/types.h>
#include <zephyr/bluetooth/bluetooth.h>
#include <zephyr/bluetooth/gap.h>
#include <zephyr/logging/log.h>

#include "ss_bt.h"

LOG_MODULE_REGISTER(bt_coded, LOG_LEVEL_INF);

// static void start_advertising_coded(struct k_work *work);
// static K_WORK_DEFINE(start_advertising_worker, start_advertising_coded);

static struct bt_le_ext_adv *adv;

static uint8_t data_buffer[] = {
    MANUFACTURER_ID_LSB, // MANUFACTURER ID (lsb)
    MANUFACTURER_ID_MSB, // MANUFACTURER ID (msb)
    SUBTYPE,             // SUBTYPE
    0x00,                // BATT %
    0x00,                // IMPEDIANCE BYTE
    0x00,                // IMPEDIANCE BYTE
    0x00,                // IMPEDIANCE BYTE
    0x00                 // IMPEDIANCE BYTE
};

static const struct bt_data ad[] = {
    BT_DATA(BT_DATA_MANUFACTURER_DATA, data_buffer, ARRAY_SIZE(data_buffer))
  };

static int create_advertising_coded(void)
{
	int err;
	struct bt_le_adv_param param = BT_LE_ADV_PARAM_INIT(
      BT_LE_ADV_OPT_EXT_ADV | BT_LE_ADV_OPT_CODED | BT_LE_ADV_OPT_USE_IDENTITY ,
      BT_GAP_ADV_FAST_INT_MIN_2,
      BT_GAP_ADV_FAST_INT_MAX_2,
      NULL);

	err = bt_le_ext_adv_create(&param, NULL, &adv);
	if (err) {
		LOG_ERR("Failed to create advertiser set (err %d)\n", err);
		return err;
	}

	LOG_INF("Created adv: \n");

	err = bt_le_ext_adv_set_data(adv, ad, ARRAY_SIZE(ad), NULL, 0);
	if (err) {
		LOG_ERR("Failed to set advertising data (err %d)\n", err);
		return err;
	}

	return 0;
}

static void start_advertising_coded(void)
{
	int err;

  LOG_INF("Starting Adv....");

	err = bt_le_ext_adv_start(adv, NULL);
	if (err) {
		LOG_ERR("Failed to start advertising set (err %d)\n", err);
		return;
	}

	LOG_INF("Advertiser set started\n");
}

static void start_coded_adv(int err)
{
  if (err) {
    LOG_ERR("Enable BT failed, err %d", err);
    return;
  } else {
    LOG_INF("BT Enabled");
  }

  err = create_advertising_coded();
  if (err) {
		LOG_ERR("Advertising failed to create (err %d)\n", err);
		return;
	}

  start_advertising_coded();
}

void en_coded_adv(void)
{
  (void)bt_enable(start_coded_adv);
}
```

## src/pwr.c
```c
#include "pwr.h"
#include "ss_bt.h"

#include <nrfx_twim.h>

#include <errno.h>
#include <zephyr/device.h>
#include <zephyr/devicetree.h>
#include <zephyr/pm/device.h>
#include <zephyr/drivers/i2c.h>
#include <zephyr/logging/log.h>

LOG_MODULE_REGISTER(pwr, LOG_LEVEL_INF);

const struct device *const i2c_bus = DEVICE_DT_GET_OR_NULL(DT_NODELABEL(i2c0));
const struct device *const bme280 = DEVICE_DT_GET_OR_NULL(DT_NODELABEL(bme280));

// void zero_twim(void) {
//   volatile void *buf0 = (volatile void *)0x40003000;
//   memset(buf0,0,0x1000);
//   // NRF_TWIM0->TASKS_STARTRX = 0;
//   // NRF_TWIM0->TASKS_STARTTX = 0;
//   // NRF_TWIM0->TASKS_STOP = 0;
//   // NRF_TWIM0->TASKS_SUSPEND = 0;
//   // NRF_TWIM0->TASKS_RESUME = 0;
//   // NRF_TWIM0->TASKS_STARTRX = 0;                /*!< (@ 0x00000000) Start TWI receive sequence                                 */
//   // NRF_TWIM0->TASKS_STARTTX = 0;                /*!< (@ 0x00000008) Start TWI transmit sequence                                */
//   // NRF_TWIM0->TASKS_STOP = 0;                   /*!< (@ 0x00000014) Stop TWI transaction. Must be issued while the*/
//   // NRF_TWIM0->TASKS_SUSPEND = 0;                /*!< (@ 0x0000001C) Suspend TWI transaction                                    */
//   // NRF_TWIM0->TASKS_RESUME = 0;                 /*!< (@ 0x00000020) Resume TWI transaction                                     */
//   // NRF_TWIM0->EVENTS_STOPPED = 0;               /*!< (@ 0x00000104) TWI stopped                                                */
//   // NRF_TWIM0->EVENTS_ERROR = 0;                 /*!< (@ 0x00000124) TWI error                                                  */
//   // NRF_TWIM0->EVENTS_SUSPENDED = 0;             /*!< (@ 0x00000148) Last byte has been sent out after the SUSPEND */
//   // NRF_TWIM0->EVENTS_RXSTARTED = 0;             /*!< (@ 0x0000014C) Receive sequence started                                   */
//   // NRF_TWIM0->EVENTS_TXSTARTED = 0;             /*!< (@ 0x00000150) Transmit sequence started                                  */
//   // NRF_TWIM0->EVENTS_LASTRX = 0;                /*!< (@ 0x0000015C) Byte boundary, starting to receive the last byte           */
//   // NRF_TWIM0->EVENTS_LASTTX = 0;                /*!< (@ 0x00000160) Byte boundary, starting to transmit the last*/
//   // NRF_TWIM0->SHORTS = 0;                       /*!< (@ 0x00000200) Shortcuts between local events and tasks                   */
//   // NRF_TWIM0->INTEN = 0;                        /*!< (@ 0x00000300) Enable or disable interrupt                                */
//   // NRF_TWIM0->INTENSET = 0;                     /*!< (@ 0x00000304) Enable interrupt                                           */
//   // NRF_TWIM0->INTENCLR = 0;                     /*!< (@ 0x00000308) Disable interrupt                                          */
//   // NRF_TWIM0->ERRORSRC = 0;                     /*!< (@ 0x000004C4) Error source                                               */
//   // NRF_TWIM0->ENABLE = 0;                       /*!< (@ 0x00000500) Enable TWIM                                                */
//   // //NRF_TWIM0->FREQUENCY = 0;                    /*!< (@ 0x00000524) TWI frequency. Accuracy depends on the HFCLK */
//   // NRF_TWIM0->ADDRESS = 0;                      /*!< (@ 0x00000588) Address used in the TWI transfer                           */

//   // volatile uint32_t *scl = (volatile uint32_t *)0x40003508;
//   // *scl = 0xFFFFFFFF;
//   // volatile uint32_t *sda = (volatile uint32_t *)0x4000350C;
//   // *sda = 0xFFFFFFFF;
//   // volatile uint32_t *list = (volatile uint32_t *)0x4000350C;
//   // *sda = 0xFFFFFFFF;

// }


void pwr_sleep_bus(void) {

  int err;

  // if (!device_is_ready(bme280)) {
	// 	LOG_ERR("%s: device not ready.\n", bme280->name);
	// } else {

  //   err = pm_device_action_run(bme280, PM_DEVICE_ACTION_SUSPEND);
  //   if(err != 0 && err != -EALREADY) {
  //     LOG_ERR("%d:Suspend failed, err %d",__LINE__,err);
  //   }
  // }

  if (!device_is_ready(i2c_bus)) {
		LOG_ERR("%s: device not ready.\n", i2c_bus->name);
	} else {

    err = pm_device_action_run(i2c_bus, PM_DEVICE_ACTION_SUSPEND);
    if(err != 0 && err != -EALREADY) {
      LOG_ERR("%d:Suspend failed, err %d",__LINE__,err);
    }
    // NRF_TWIM0->ENABLE = 6;
    // NRF_TWIM0->ENABLE = 0;

  }
  // TODO : NRFX API to disable ADC


  disable_bt();
}


void pwr_wake_bus(void) {

    int err;
    // NRF_TWIM0->ENABLE = 0;
    // NRF_TWIM0->ENABLE = 6;
    err = pm_device_action_run(i2c_bus, PM_DEVICE_ACTION_RESUME);
    if(err != 0 && err != -EALREADY) {
      LOG_ERR("%d:Wake failed, err %d",__LINE__,err);
    }

    // err = pm_device_action_run(bme280, PM_DEVICE_ACTION_RESUME);
    // if(err != 0 && err != -EALREADY) {
    //   LOG_ERR("%d:Wake failed, err %d",__LINE__,err);
    // }

    // TODO : NRFX API to enable ADC
  }
```

## src/pwr.h
```c
#ifndef RS_PWR
#define RS_PWR

void pwr_sleep_bus(void);
void pwr_wake_bus(void);

#endif // RS_PWR
```

## src/ss_bt.c
```c
#include "ss_bt.h"

#include <zephyr/bluetooth/bluetooth.h>
#include <zephyr/bluetooth/gap.h>
#include <zephyr/logging/log.h>

LOG_MODULE_REGISTER(ss_bt, LOG_LEVEL_INF);

#define BT_MAX_INTERVAL 0x4000

int32_t bt_ready = 0;

static struct bt_le_adv_param *adv_param = BT_LE_ADV_PARAM(BT_LE_ADV_OPT_USE_IDENTITY,
                                                           TX_RATE - 5,
                                                           TX_RATE,
                                                           NULL);

static uint8_t data_buffer[] = {
    MANUFACTURER_ID_LSB, // MANUFACTURER ID (lsb)
    MANUFACTURER_ID_MSB, // MANUFACTURER ID (msb)
    SUBTYPE,             // SUBTYPE
    0x00,                // BATT_MV 1
    0x00,                // BATT_MV 2
    0x00,                // T1
    0x00,                // T2
    0x00,                // P1
    0x00,                // P2
    0x00,                // H1
    0x00                 // H2
};

static const struct bt_data ad_mnft_data_buffer[] = {BT_DATA(BT_DATA_MANUFACTURER_DATA, data_buffer, ARRAY_SIZE(data_buffer))};

static const struct bt_data sd[] = {BT_DATA(BT_DATA_NAME_COMPLETE, DEVICE_NAME, DEVICE_NAME_LEN)};

void ss_bt_update(
  struct bme280_sensor_vals temp,
  struct bme280_sensor_vals press,
  struct bme280_sensor_vals humidity,
  int16_t batt)
{
  memcpy(&data_buffer[3],&batt,sizeof(batt));
  data_buffer[5] = (uint8_t)temp.val1;
  data_buffer[6] = (uint8_t)temp.val2;
  data_buffer[7] = (uint8_t)press.val1;
  data_buffer[8] = (uint8_t)press.val2;
  data_buffer[9] = (uint8_t)humidity.val1;
  data_buffer[10] = (uint8_t)humidity.val2;

  while(bt_ready == 0) {
    k_msleep(100);
    LOG_INF("Waiting for BT to start");
  }

  int err = bt_le_adv_start(adv_param,
                        ad_mnft_data_buffer,
                        ARRAY_SIZE(ad_mnft_data_buffer),
                        sd,
                        ARRAY_SIZE(sd));
  if (err) {
    LOG_ERR("BLE start err %d", err);
  }


}

void bt_ready_cb(int err)
{

  bt_ready = 1;

  if (err)
  {
    LOG_ERR("BT Error, err: %d", err);
  }
}

void init_ss_bt(void)
{
  int32_t err;

  err = bt_enable(bt_ready_cb);

}

void disable_bt(void) {
  int err = bt_le_adv_stop();

  if(err) {
    LOG_ERR("Couldn't disable BT, err %d", err);
  }
}
```

## src/ss_bt.h
```c
#ifndef SS_BT
#define SS_BT

#include <stdint.h>
#include "bme280.h"

#define MANUFACTURER_ID 0x0877
#define SUBTYPE 0x7E

#define MANUFACTURER_ID_LSB ((MANUFACTURER_ID >> 0) & 0xFF)
#define MANUFACTURER_ID_MSB ((MANUFACTURER_ID >> 8) & 0xFF)

#define DEVICE_NAME CONFIG_BT_DEVICE_NAME
#define DEVICE_NAME_LEN (sizeof(DEVICE_NAME) - 1)
#define TX_RATE ((CONFIG_BT_TX_RATE * 16) / 10)

void init_ss_bt(void);
void disable_bt(void);
void ss_bt_update(
  struct bme280_sensor_vals temp,
  struct bme280_sensor_vals press,
  struct bme280_sensor_vals humidity,
  int16_t batt);

#endif
```
